## firmware/sdkconfig.defaults
```kconfig
# Sdrumo project defaults
# Memory-tuned mbedTLS for HTTPS client on esp32.

CONFIG_MBEDTLS_DYNAMIC_BUFFER=y
CONFIG_MBEDTLS_SSL_IN_CONTENT_LEN=4096
CONFIG_MBEDTLS_SSL_OUT_CONTENT_LEN=4096
CONFIG_MBEDTLS_CERTIFICATE_BUNDLE=y
CONFIG_MBEDTLS_CERTIFICATE_BUNDLE_DEFAULT_FULL=y
CONFIG_ESP_TLS_USING_MBEDTLS=y

# HTTP client tuning
CONFIG_ESP_HTTP_CLIENT_ENABLE_HTTPS=y
CONFIG_ESP_HTTP_CLIENT_ENABLE_BASIC_AUTH=n

# Smaller default task stacks where safe
CONFIG_ESP_MAIN_TASK_STACK_SIZE=4096
```

## firmware/src/Kconfig.projbuild
```kconfig
menu "Sdrumo Application"

    config SDRUMO_API_BASE_URL
        string "Sdrumo API base URL"
        default "https://api.sdrumo.example"
        help
            Base URL of the Sdrumo backend (no trailing slash).

    config SDRUMO_USE_HTTPS
        bool "Use HTTPS for API calls"
        default y
        help
            Enable TLS via mbedTLS. Disable only for LAN/development.

    config SDRUMO_API_TIMEOUT_MS
        int "API request timeout (ms)"
        default 5000
        range 1000 30000

    config SDRUMO_API_MAX_RETRIES
        int "Max retries on transient API failure"
        default 3
        range 0 10

    config SDRUMO_API_RESP_BUF_SIZE
        int "HTTP response buffer size (bytes)"
        default 8192
        range 1024 16384

endmenu
```
